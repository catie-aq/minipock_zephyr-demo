## app/base_application/drivers/Kconfig
```kconfig
# Copyright (c) 2023 CATIE
# SPDX-License-Identifier: Apache-2.0

menu "Drivers"
rsource "sensor/Kconfig"
endmenu
```

## app/base_application/drivers/sensor/Kconfig
```kconfig
# Copyright (c) 2023 CATIE
# SPDX-License-Identifier: Apache-2.0

if SENSOR
rsource "hls-lfcd2/Kconfig"
endif
```

## app/base_application/drivers/sensor/hls-lfcd2/Kconfig
```kconfig
# Copyright (c) 2023 CATIE
# SPDX-License-Identifier: Apache-2.0

config HLS_LFCD2
	bool "HLS LFCD2 LiDAR"
	default y
	depends on DT_HAS_HLS_LFCD2_ENABLED
	select PWM
	help
	  Enable HLS LFCD2 LiDAR.
```

## drivers/sensor/hls-lfcd2/Kconfig
```kconfig
# Copyright (c) 2023 CATIE
# SPDX-License-Identifier: Apache-2.0

config HLS_LFCD2
	bool "Example sensor"
	default y
	depends on DT_HAS_HLS_LFCD2_ENABLED
	select PWM
	help
	  Enable example sensor
```

## west.yml
```yaml
# Copyright (c) 2023 CATIE
# SPDX-License-Identifier: Apache-2.0

manifest:
  remotes:
    - name: zephyrproject-rtos
      url-base: https://github.com/zephyrproject-rtos
    - name: micro-ROS
      url-base: https://github.com/micro-ROS
    - name: catie-6tron
      url-base: https://github.com/catie-aq

  group-filter: [+optional]

  projects:
    - name: zephyr
      remote: zephyrproject-rtos
      revision: 69ad8937b1696a42191f9b5d803bdfa8827192cd
      import:
        name-allowlist:
          - cmsis
          - hal_stm32
          - hal_nordic
          - fatfs
          - nanopb
          - mbedtls
          - hostap
          - mcuboot
    - name: micro_ros_zephyr_module
      remote: catie-6tron
      revision: minipock-jazzy
      path: modules/micro_ros_zephyr_module
    - name: 6tron-manifest
      remote: catie-6tron
      repo-path: zephyr_6tron-manifest
      revision: v3.7.0+202412
      path: 6tron/6tron-manifest
      import:
        name-allowlist:
          - 6tron_connector
          - zest_core_stm32h753zi
    - name: ldrobot-ld19
      remote: catie-6tron
      repo-path: zephyr_ldrobot-ld19
      revision: 6bcd36bedceb70652d99582da80f9fbe5684b849
      path: 6tron/ldrobot-ld19
    - name: zest_radio_wifi
      remote: catie-6tron
      repo-path: zephyr_zest-radio-wifi
      revision: 8b67f8dde96b8f6766b5699fb685f8f259266e5b
      path: 6tron/shields/zest_radio_wifi
    - name : sparkfunc_paa5160e1
      remote: catie-6tron
      repo-path: zephyr_sparkfunc-paa5160e1
      revision: main
      path: 6tron/zephyr_sparkfun-paa5160e1
```
